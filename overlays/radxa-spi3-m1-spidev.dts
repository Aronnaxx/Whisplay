/dts-v1/;
/plugin/;

/*
 * Enable SPI3 (M1 pin group, CS0) with a userspace spidev node on the Radxa
 * Zero 3W 40-pin header. The Whisplay HAT's ST7789 LCD is driven from
 * userspace: runtime/whisplay.py opens /dev/spidev3.0 (spi_bus=3, cs=0) on this
 * board. Mainline rk3566 ships SPI3 disabled, so without this the device node
 * never appears and the daemon cannot drive the display.
 *
 * The Linux SPI bus number comes from rk3568.dtsi's existing `aliases { spi3 =
 * &spi3; }`, so enabling &spi3 yields /dev/spidev3.0.
 *
 * NOTE (bring-up): if overlay application fails resolving &spi3m1_pins /
 * &spi3m1_cs0, those pinctrl groups were dropped from the base DTB by
 * /omit-if-no-ref/. The fallback is to inline the rockchip,pins for the SPI3
 * M1 group here instead of referencing the labels.
 */

/ {
	compatible = "radxa,zero-3w", "rockchip,rk3566";

	fragment@0 {
		target = <&spi3>;
		__overlay__ {
			status = "okay";
			pinctrl-names = "default";
			pinctrl-0 = <&spi3m1_pins &spi3m1_cs0>;
			#address-cells = <1>;
			#size-cells = <0>;

			spidev@0 {
				compatible = "rohm,dh2228fv"; /* generic spidev binding */
				reg = <0>;
				spi-max-frequency = <50000000>;
			};
		};
	};
};
